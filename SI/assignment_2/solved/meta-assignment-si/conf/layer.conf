## SI/assignment_2/solved/meta-assignment-si/conf/layer.conf
```bitbake
# We have a conf and classes directory, add to BBPATH
BBPATH .= ":${LAYERDIR}"

# We have recipes-* directories, add to BBFILES
BBFILES += "${LAYERDIR}/recipes-*/*/*.bb \
            ${LAYERDIR}/recipes-*/*/*.bbappend"

BBFILE_COLLECTIONS += "meta-assignment-si"
BBFILE_PATTERN_meta-assignment-si = "^${LAYERDIR}/"
BBFILE_PRIORITY_meta-assignment-si = "6"

LAYERDEPENDS_meta-assignment-si = "core"
LAYERSERIES_COMPAT_meta-assignment-si = "dunfell"
```
